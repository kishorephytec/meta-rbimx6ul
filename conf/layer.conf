## conf/layer.conf
```bitbake
# We have a conf and classes directory, add to BBPATH
BBPATH .= ":${LAYERDIR}"

# We have recipes-* directories, add to BBFILES
BBFILES += "${LAYERDIR}/recipes-*/*/*.bb \
            ${LAYERDIR}/recipes-*/*/*.bbappend"

BBFILE_COLLECTIONS += "meta-rbimx6ul"
BBFILE_PATTERN_meta-rbimx6ul = "^${LAYERDIR}/"
BBFILE_PRIORITY_meta-rbimx6ul = "6"
LAYERDEPENDS_meta-rbimx6ul = "core"
LAYERSERIES_COMPAT_meta-rbimx6ul = "sumo"

# Board related package or features of the image can be appended here
# IMAGE_INSTALL_append += "wayland weston weston-examples libdrm-tests"
```

## meta-bsp/conf/layer.conf
```bitbake
# We have a conf and classes directory, add to BBPATH
BBPATH .= ":${LAYERDIR}"

# We have recipes-* directories, add to BBFILES
BBFILES += "${LAYERDIR}/recipes-*/*/*.bb \
            ${LAYERDIR}/recipes-*/*/*.bbappend"

BBFILE_COLLECTIONS += "meta-bsp"
BBFILE_PATTERN_meta-bsp = "^${LAYERDIR}/"
BBFILE_PRIORITY_meta-bsp = "6"

LAYERDEPENDS_meta-bsp = "core"
LAYERSERIES_COMPAT_meta-bsp = "sumo"

# BSP and system related package or features of the image can be appended here
IMAGE_INSTALL_append = " mtd-utils usbutils ethtool systemd-analyze busybox-udhcpc"
IMAGE_INSTALL_append = " bluez5 openssl openssh openvpn libmodbus iproute2 can-utils"
IMAGE_INSTALL_append = " wilc3000-firmware"
```

## meta-core/conf/layer.conf
```bitbake
# We have a conf and classes directory, add to BBPATH
BBPATH .= ":${LAYERDIR}"

# We have recipes-* directories, add to BBFILES
BBFILES += "${LAYERDIR}/recipes-*/*/*.bb \
            ${LAYERDIR}/recipes-*/*/*.bbappend"

BBFILE_COLLECTIONS += "meta-core"
BBFILE_PATTERN_meta-core = "^${LAYERDIR}/"
BBFILE_PRIORITY_meta-core = "6"

LAYERDEPENDS_meta-core = "core"
LAYERSERIES_COMPAT_meta-core = "hardknott"

# package-group or DISTRO features of the image can be appended here
IMAGE_INSTALL_append = " phytec-qtdemo"
IMAGE_INSTALL_append = " dt-utils rauc rauc-flash-nand rauc-hawkbit-updater"
#IMAGE_INSTALL_append = " rauc-hawkbit"
IMAGE_INSTALL_append = " coreutils keyutils lvm2 e2fsprogs e2fsprogs-mke2fs util-linux"
```

## meta-libraries/conf/layer.conf
```bitbake
# We have a conf and classes directory, add to BBPATH
BBPATH .= ":${LAYERDIR}"

# We have recipes-* directories, add to BBFILES
BBFILES += "${LAYERDIR}/recipes-*/*/*.bb \
            ${LAYERDIR}/recipes-*/*/*.bbappend"

BBFILE_COLLECTIONS += "meta-libraries"
BBFILE_PATTERN_meta-libraries = "^${LAYERDIR}/"
BBFILE_PRIORITY_meta-libraries = "6"

LAYERDEPENDS_meta-libraries = "core"
LAYERSERIES_COMPAT_meta-libraries = "hardknott"

# Custom created/developed libraries of the image can be appended here
IMAGE_INSTALL_append = " json-c libgpiod paho-mqtt-c"
IMAGE_INSTALL_append = " python3 python3-pip python3-paho-mqtt python3-pymodbus python3-pyserial python3-six python3-requests python3-flask python3-flup"
IMAGE_INSTALL_append = " sqlite3 lighttpd wpa-supplicant libqmi"
IMAGE_INSTALL_append = " libwebsockets ntp tzdata nodejs"
```
